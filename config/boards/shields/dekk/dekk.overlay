/ {
    chosen {
        zmk,kscan = &kscan;
    };

    kscan: kscan {
        compatible = "zmk,kscan-gpio-direct";
        label = "KSCAN";
        input-gpios = 
            <&pro_micro 1 (GPIO_ACTIVE_LOW | GPIO_PULL_UP)>,
            <&pro_micro 0 (GPIO_ACTIVE_LOW | GPIO_PULL_UP)>,
            <&pro_micro 2 (GPIO_ACTIVE_LOW | GPIO_PULL_UP)>,
            <&pro_micro 3 (GPIO_ACTIVE_LOW | GPIO_PULL_UP)>;
    };
};